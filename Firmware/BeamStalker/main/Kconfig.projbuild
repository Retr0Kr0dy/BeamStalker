## Firmware/BeamStalker/main/Kconfig.projbuild
```kconfig
menu "BeamStalker Build Configuration"

config CONSOLE_STORE_HISTORY
    bool "Store command history in flash"
    default y
    help
        Linenoise line editing library provides functions to save and load
        command history. If this option is enabled, initalizes a FAT filesystem
        and uses it to store command history.

config CONSOLE_MAX_COMMAND_LINE_LENGTH
    int "Maximum command line length"
    default 1024
    help
        This value marks the maximum length of a single command line. Once it is
        reached, no more characters will be accepted by the console.

config M5_BOARD
    bool "Is M5Stack hardware"
    default n
    help
        Specify if board is using M5Stack libs.

config HELTEC_BOARD
    bool "Is Heltec hardware"
    default n
    help
        Specify if board is using Heltec libs.
                        
config HAS_DISPLAY
    bool "Has display"
    default n
    help
        Specify if board has screen.
        
config HAS_SSD1306_DISPLAY
    bool "Has ssd1306 display"
    default n
    help
        Specify if board is using SSD1306 libs.
                        
config HAS_SDCARD
    bool "Has sd card"
    default n
    help
        Specify if board has sd card.
       
# SD card specific        
menu "SD CARD SPI Configuration"

    config FORMAT_IF_MOUNT_FAILED
        bool "Format the card if mount failed"
        default n
        help
            If this config item is set, format_if_mount_failed will be set to true and the card will be formatted if
            the mount has failed.

    config FORMAT_SD_CARD
        bool "Format the card as a part of the example"
        default n
        help
            If this config item is set, the card will be formatted as a part of the example.

    config PIN_MOSI
        int "MOSI GPIO number"
        default 14
    config PIN_MISO
        int "MISO GPIO number"
        default 39

    config PIN_CLK
        int "CLK GPIO number"
        default 40

    config PIN_CS
        int "CS GPIO number"
        default 12
endmenu
        # SD card end

endmenu
```
